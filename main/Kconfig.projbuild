## main/Kconfig.projbuild
```kconfig
menu "ESP32 Scope"

config SCOPE_SAMPLE_RATE_HZ
    int "ADC sample rate (samples/second)"
    range 20000 2000000
    default 200000
    help
        Continuous ADC conversion rate. 200 kSa/s is a practical fast
        default when samples are streamed over Wi-Fi.

config SCOPE_WIFI_SSID
    string "Wi-Fi SSID"
    default ""

config SCOPE_WIFI_PASSWORD
    string "Wi-Fi password"
    default ""

config SCOPE_MDNS_HOSTNAME
    string "Local network hostname"
    default "esp32scope"
    help
        Hostname advertised over mDNS. Open the web interface at
        http://<hostname>.local/ from a device on the same network.

endmenu
```

## sdkconfig.defaults
```kconfig
CONFIG_IDF_TARGET="esp32"
CONFIG_ESP_DEFAULT_CPU_FREQ_MHZ_240=y
CONFIG_ESP_DEFAULT_CPU_FREQ_MHZ=240
CONFIG_SCOPE_SAMPLE_RATE_HZ=200000
CONFIG_LWIP_TCP_SND_BUF_DEFAULT=16384
CONFIG_LWIP_TCP_WND_DEFAULT=16384
CONFIG_SCOPE_MDNS_HOSTNAME="esp32scope"
CONFIG_ESPTOOLPY_FLASHMODE_DIO=y
CONFIG_ESPTOOLPY_FLASHFREQ_40M=y
CONFIG_ESPTOOLPY_FLASHSIZE_4MB=y
CONFIG_HTTPD_WS_SUPPORT=y
CONFIG_PARTITION_TABLE_CUSTOM=y
CONFIG_PARTITION_TABLE_CUSTOM_FILENAME="partitions.csv"
CONFIG_SCOPE_WIFI_SSID="CGA2121_jbfFjGQ"
CONFIG_SCOPE_WIFI_PASSWORD="aKxG9xN6vKaYwYjLN4"
```
